#include "font_adafruit_fixed_5x7.h"

#include <pgmspace.h>

#include "roo_display/core/buffered_drawing.h"
#include "roo_io/text/unicode.h"

namespace roo_display {

// Original Adafruit_GFX 5x7 font, ASCII
static const uint8_t font[] PROGMEM = {
    0x00, 0x00, 0x00, 0x00, 0x00, 0x3E, 0x5B, 0x4F, 0x5B, 0x3E, 0x3E, 0x6B,
    0x4F, 0x6B, 0x3E, 0x1C, 0x3E, 0x7C, 0x3E, 0x1C, 0x18, 0x3C, 0x7E, 0x3C,
    0x18, 0x1C, 0x57, 0x7D, 0x57, 0x1C, 0x1C, 0x5E, 0x7F, 0x5E, 0x1C, 0x00,
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    0x00, 0x00, 0x00};

static int16_t ascent = 6;
static int16_t descent = -1;
static int16_t linegap = 2;
static int16_t advance = 6;

FontAdafruitFixed5x7::FontAdafruitFixed5x7() {
  init(
      FontMetrics(ascent, descent, linegap, 0, descent, advance - 1, ascent, 0),
      FontProperties(
          FontProperties::CHARSET_ASCII, FontProperties::SPACING_MONOSPACE,
          FontProperties::SMOOTHING_NONE, FontProperties::KERNING_NONE));
}

void drawGlyph(const Surface& s, char32_t code, Color color, bool whitespace) {
  int16_t x = s.dx();
  int16_t y = s.dy();
  if (!s.clip_box().intersects(
          Box(x, y - ascent, x + advance - 1, y - descent + linegap))) {
    return;
  }
  y -= ascent;
  if (code < 32 || code > 127) return;
  if (s.fill_mode() == FILL_MODE_VISIBLE) {
    ClippingBufferedPixelFiller filler(s.out(), color, s.clip_box(),
                                       s.blending_mode());
    for (int8_t i = 0; i < 5; i++) {
      uint8_t line = pgm_read_byte(font + code * 5 + i);
      for (int8_t j = 0; j < 8; j++) {
        if (line & 0x1) filler.fillPixel(x + i, y + j);
        line >>= 1;
      }
    }
  } else {
    ClippingBufferedPixelWriter writer(s.out(), s.clip_box(),
                                       s.blending_mode());
    for (int8_t i = 0; i < 5; i++) {
      uint8_t line = pgm_read_byte(font + code * 5 + i);
      for (int8_t j = 0; j < 8; j++) {
        writer.writePixel(x + i, y + j, (line & 0x1) ? color : s.bgcolor());
        line >>= 1;
      }
      if (whitespace) {
        for (int8_t j = 0; j < 8; j++) {
          writer.writePixel(x + 5, y + j, s.bgcolor());
        }
      }
    }
  }
}

void FontAdafruitFixed5x7::drawHorizontalString(const Surface& s,
                                                const char* utf8_data,
                                                uint32_t size,
                                                Color color) const {
  Surface news(s);
  roo_io::Utf8Decoder decoder(utf8_data, size);
  char32_t ch;
  if (!decoder.next(ch)) return;
  while (true) {
    char32_t next;
    bool has_next = decoder.next(next);
    drawGlyph(news, ch, color, has_next);
    if (!has_next) return;
    news.set_dx(news.dx() + advance);
    ch = next;
  };
}

bool FontAdafruitFixed5x7::getGlyphMetrics(char32_t code, FontLayout layout,
                                           GlyphMetrics* result) const {
  *result = GlyphMetrics(0, descent, 4, ascent, advance);
  return true;
}

GlyphMetrics FontAdafruitFixed5x7::getHorizontalStringMetrics(
    const char* utf8_data, uint32_t size) const {
  roo_io::Utf8Decoder decoder(utf8_data, size);
  int16_t length = 0;
  char32_t ignored;
  while (decoder.next(ignored)) {
    length++;
  }
  return GlyphMetrics(0, descent, advance * length - 2, ascent,
                      advance * length - 1);
}

uint32_t FontAdafruitFixed5x7::getHorizontalStringGlyphMetrics(
    const char* utf8_data, uint32_t size, GlyphMetrics* result, uint32_t offset,
    uint32_t max_count) const {
  roo_io::Utf8Decoder decoder(utf8_data, size);
  uint32_t i = 0;
  uint32_t count = 0;
  char32_t ignored;
  while (decoder.next(ignored) && count < max_count) {
    uint16_t running = 0;
    if (i >= offset) {
      result[count++] = GlyphMetrics(running, descent, running + 4, ascent,
                                     running + advance);
    }
    running += advance;
    ++i;
  }
  return count;
}

}  // namespace roo_display
